## conf/layer.conf
```bitbake
# We have a conf and classes directory, add to BBPATH
BBPATH .= ":${LAYERDIR}"

# We have recipes-* directories, add to BBFILES
BBFILES += "${LAYERDIR}/recipes-*/*/*.bb \
            ${LAYERDIR}/recipes-*/*/*.bbappend"

BBFILE_COLLECTIONS += "meta-dart"
BBFILE_PATTERN_meta-dart = "^${LAYERDIR}/"
BBFILE_PRIORITY_meta-dart = "6"

LAYERDEPENDS_meta-dart = "core"
LAYERSERIES_COMPAT_meta-dart = "dunfell"
```
